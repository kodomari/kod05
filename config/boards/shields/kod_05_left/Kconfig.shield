## config/boards/shields/kod_05_right/Kconfig.shield
```kconfig
config SHIELD_KOD_05_RIGHT
    def_bool $(shields_list_contains,kod_05_right)
    select INPUT
    select ZMK_POINTING
```

## config/boards/shields/kod_05_right/kconfig.defconfig
```kconfig
if SHIELD_KOD_05_LEFT

config ZMK_KEYBOARD_NAME
    default "Kod-05"

config ZMK_SPLIT_ROLE_CENTRAL
    default n

endif

if SHIELD_KOD_05_RIGHT

config ZMK_KEYBOARD_NAME
    default "Kod-05"

config ZMK_SPLIT_ROLE_CENTRAL
    default y

endif

if SHIELD_KOD_05_LEFT || SHIELD_KOD_05_RIGHT

config ZMK_SPLIT
    default y

endif
```
